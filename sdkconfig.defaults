## sdkconfig.defaults
```kconfig
# 定时器任务堆栈配置
# 增加 esp_timer 任务堆栈大小，默认 3584，可能不够
CONFIG_ESP_TIMER_TASK_STACK_SIZE=8192

# ==================== mbedTLS 配置优化 ====================
# 1. 启用外部内存分配（使用 PSRAM）
CONFIG_MBEDTLS_EXTERNAL_MEM_ALLOC=y

# 2. 增加 mbedTLS 缓冲区大小
CONFIG_MBEDTLS_SSL_IN_CONTENT_LEN=16384
CONFIG_MBEDTLS_SSL_OUT_CONTENT_LEN=16384

# 3. 启用动态缓冲区
CONFIG_MBEDTLS_DYNAMIC_BUFFER=y

# 4. 启用所有 TLS 版本（优先级：TLS 1.3 > TLS 1.2 > TLS 1.1 > TLS 1.0）
CONFIG_MBEDTLS_SSL_PROTO_TLS1_3=y
CONFIG_MBEDTLS_SSL_PROTO_TLS1_2=y
CONFIG_MBEDTLS_SSL_PROTO_TLS1_1=y
CONFIG_MBEDTLS_SSL_PROTO_TLS1=y

# 5. 启用常用的密钥交换方式
CONFIG_MBEDTLS_KEY_EXCHANGE_RSA=y
CONFIG_MBEDTLS_KEY_EXCHANGE_ELLIPTIC_CURVE=y
CONFIG_MBEDTLS_KEY_EXCHANGE_ECDHE_RSA=y
CONFIG_MBEDTLS_KEY_EXCHANGE_ECDHE_ECDSA=y
CONFIG_MBEDTLS_KEY_EXCHANGE_ECDH_ECDSA=y
CONFIG_MBEDTLS_KEY_EXCHANGE_ECDH_RSA=y

# 6. 增加证书存储大小
CONFIG_MBEDTLS_CERTIFICATE_BUNDLE_MAX_CERTS=300

# 7. 禁用证书验证（仅用于开发测试，提升兼容性）
CONFIG_MBEDTLS_SSL_INSECURE=y

# 7.1 禁用证书要求
CONFIG_MBEDTLS_SSL_SERVER_NAME_INDICATION=y
CONFIG_MBEDTLS_SSL_TRUNCATED_HMAC=y

# 9. 优化 mbedTLS 内存使用
CONFIG_MBEDTLS_ASYMMETRIC_CONTENT_LEN=y

# 10. 启用更多 TLS 1.3 支持
CONFIG_MBEDTLS_SSL_SESSION_TICKETS=y
CONFIG_MBEDTLS_SSL_ALPN=y

# 9. 启用更多椭圆曲线支持
CONFIG_MBEDTLS_ECP_DP_SECP192R1_ENABLED=y
CONFIG_MBEDTLS_ECP_DP_SECP224R1_ENABLED=y
CONFIG_MBEDTLS_ECP_DP_SECP256R1_ENABLED=y
CONFIG_MBEDTLS_ECP_DP_SECP384R1_ENABLED=y
CONFIG_MBEDTLS_ECP_DP_SECP521R1_ENABLED=y
CONFIG_MBEDTLS_ECP_DP_SECP192K1_ENABLED=y
CONFIG_MBEDTLS_ECP_DP_SECP224K1_ENABLED=y
CONFIG_MBEDTLS_ECP_DP_SECP256K1_ENABLED=y
CONFIG_MBEDTLS_ECP_DP_BP256R1_ENABLED=y
CONFIG_MBEDTLS_ECP_DP_BP384R1_ENABLED=y
CONFIG_MBEDTLS_ECP_DP_BP512R1_ENABLED=y
CONFIG_MBEDTLS_ECP_DP_CURVE25519_ENABLED=y

# 10. 启用 TLS 1.3 所需的密码套件
CONFIG_MBEDTLS_POLY1305_C=y
CONFIG_MBEDTLS_CHACHA20_C=y
CONFIG_MBEDTLS_HKDF_C=y

# 分区表配置（使用自定义分区表，16MB Flash）
CONFIG_PARTITION_TABLE_CUSTOM=y
CONFIG_PARTITION_TABLE_CUSTOM_FILENAME="partitions.csv"
CONFIG_ESPTOOLPY_FLASHSIZE_16MB=y

# PSRAM 配置（ESP32-S3 DevKitC-1 通常配备 Octal SPI PSRAM）
CONFIG_SPIRAM=y
CONFIG_ESP32S3_SPIRAM_SUPPORT=y
CONFIG_SPIRAM_MODE_OCT=y
CONFIG_SPIRAM_TYPE_AUTO=y
CONFIG_SPIRAM_SPEED_80MHZ=y
CONFIG_SPIRAM_BOOT_INIT=y

# LWIP 配置 - 增加 socket 上限，满足多模块并发需求
CONFIG_LWIP_MAX_SOCKETS=30

# ESP-TLS 配置 - 允许跳过服务器证书验证（WebHook/企业微信等 HTTPS 请求无需内置 CA 证书）
CONFIG_ESP_TLS_INSECURE=y
CONFIG_ESP_TLS_SKIP_SERVER_CERT_VERIFY=y
```
